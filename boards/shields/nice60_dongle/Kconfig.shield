## boards/shields/nice60_dongle/Kconfig.shield
```kconfig
# Copyright (c) 2020 The ZMK Contributors
# SPDX-License-Identifier: MIT
config SHIELD_nice60_dongle
	def_bool $(shields_list_contains,nice60_dongle)
```

## config/Kconfig.defconfig
```kconfig
# Copyright (c) 2021 Nick Winans
# SPDX-License-Identifier: MIT

if SHIELD_nice60_dongle

config ZMK_KEYBOARD_NAME
    default "nice!60_dongle"

config ZMK_SPLIT_BLE_ROLE_CENTRAL
	default y

config ZMK_USB
	default y

config ZMK_SPLIT
	default y

config ZMK_BLE
	default y

endif

if BOARD_NICE60

config ZMK_KEYBOARD_NAME
    default "nice!60"

config ZMK_SPLIT_BLE_ROLE_CENTRAL
	default n

config ZMK_SPLIT
	default y

config ZMK_BLE
	default y

endif
```
